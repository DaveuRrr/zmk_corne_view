#include <dt-bindings/zmk/mouse.h>

#define ZMK_MOUSE_DEFAULT_MOVE_VAL 1   // 600
#define ZMK_MOUSE_DEFAULT_SCRL_VAL 1     // 10

&mmv {
    acceleration-exponent = <1>;         // 1
    time-to-max-speed-ms = <30000>;      // 300
    delay-ms = <0>;                      // 0
};

&msc {
    acceleration-exponent = <0>;         // 0
    time-to-max-speed-ms = <30000>;      // 300
    delay-ms = <0>;                      // 0
};